
#include "st7735.h"
#include "main.h"
//#include "gpio.h"
#include "st7735_pins.h"
#include <stdio.h>

#define BIN_WIDTH	6

static const uint8_t Font[] = {
  0x00, 0x00, 0x00, 0x00, 0x00,
  0x3E, 0x5B, 0x4F, 0x5B, 0x3E,
  0x3E, 0x6B, 0x4F, 0x6B, 0x3E,
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  0x00, 0x00, 0x00, 0x00, 0x00,
};

static uint16_t screen_buffer[ST7735_HEIGHT * ST7735_WIDTH];

static uint16_t init_array[] = {
		D2C(ST7735_FRMCTR1),  0x01, 0x2C, 0x2D,
		D2C(ST7735_FRMCTR2),  0x01, 0x2C, 0x2D,
		D2C(ST7735_FRMCTR3),  0x01, 0x2C, 0x2D, 0x01, 0x2C, 0x2D,
		D2C(ST7735_INVCTR),   0x07,
		D2C(ST7735_PWCTR1),   0xA2, 0x02, 0x84,
		D2C(ST7735_PWCTR2),   0xC5,
		D2C(ST7735_PWCTR3),   0x0A, 0x00,
		D2C(ST7735_PWCTR4),   0x8A, 0x2A,
		D2C(ST7735_PWCTR5),   0x8A, 0xEE,
		D2C(ST7735_VMCTR1),   0x0E,
		D2C(ST7735_GAMCTRP1), 0x0F, 0x1A, 0x0F, 0x18, 0x2F, 0x28, 0x20, 0x22, 0x1F, 0x1B, 0x23, 0x37, 0x00, 0x07, 0x02, 0x10,
		D2C(ST7735_GAMCTRN1), 0x0F, 0x1B, 0x0F, 0x17, 0x33, 0x2C, 0x29, 0x2E, 0x30, 0x30, 0x39, 0x3F, 0x00, 0x07, 0x03, 0x10,
		D2C(ST7735_EXTCTRL), 0x01,
		D2C(ST7735_COLMOD),   0x05,
		D2C(ST7735_MADCTL),  0xA0
};

static void st7735_cmd(uint8_t cmd)
{
	ST7735_SET_COMMAND;
	SPI_START;
	HAL_SPI_Transmit(&st7735_spi, &cmd, 1, HAL_MAX_DELAY);
	SPI_STOP;
}

static void st7735_data(uint8_t data)
{
	ST7735_SET_DATA;
	SPI_START;
	HAL_SPI_Transmit(&st7735_spi, &data, 1, HAL_MAX_DELAY);
	SPI_STOP;
}

static void st7735_transmit16(uint16_t value)
{
	if (value & 0x100)
		st7735_cmd(value);
	else
		st7735_data(value);
}

static void st7735_data16(uint16_t data)
{
	st7735_data(data >> 8);
	st7735_data(data);
}

static void st7735_set_window(uint8_t x, uint8_t y, uint8_t width, uint8_t height)
{
	st7735_cmd(ST7735_CASET);
	st7735_data16(ST7735_OFFSET_X + x);
	st7735_data16(ST7735_OFFSET_X + x + width - 1);

	st7735_cmd(ST7735_RASET);
	st7735_data16(ST7735_OFFSET_Y + y);
	st7735_data16(ST7735_OFFSET_Y + y + height - 1);
}

static void st7735_put_pixel(uint8_t x, uint8_t y, uint16_t color)
{
	screen_buffer[x + y*ST7735_WIDTH] = color;
}

void ST7735_Init(void)
{
	HAL_GPIO_WritePin(ST7735_RST_PORT, ST7735_RST_PIN, GPIO_PIN_RESET);
	HAL_Delay(100);
	HAL_GPIO_WritePin(ST7735_RST_PORT, ST7735_RST_PIN, GPIO_PIN_SET);
	HAL_Delay(100);

	for (uint16_t i = 0; i < sizeof(init_array)/sizeof(init_array[0]); i++)
		st7735_transmit16(init_array[i]);

	HAL_Delay(200);

	st7735_cmd(ST7735_SLPOUT);
	HAL_Delay(120);

	st7735_cmd(ST7735_DISPON);
}

void ST7735_Update(void)
{
	st7735_set_window(0, 0, ST7735_WIDTH, ST7735_HEIGHT);

	st7735_cmd(ST7735_RAMWR);

	ST7735_SET_DATA;
	SPI_START;
	HAL_SPI_Transmit(&st7735_spi, (uint8_t *)screen_buffer, sizeof(screen_buffer), HAL_MAX_DELAY);
	SPI_STOP;
}

void ST7735_WriteChar(uint8_t x, uint8_t y, char c, uint16_t color)
{
	uint8_t line;
	uint8_t i, j;

	for (i = 0; i < 6; i++) {
		if (i == 5)
			line = 0;
		else
			line = Font[(c * 5) + i];
		for (j = 0; j < 8; j++) {
			if (line & 0x1)
				st7735_put_pixel(x+i, y+j, color);
			line >>= 1;
		}
	}
}

void ST7735_WriteString(uint8_t x, uint8_t y, char *s, uint16_t color)
{
	while (*s) {
		ST7735_WriteChar(x, y, *s, color);
		x += 6;
		if ((x + 6) > ST7735_WIDTH) {
			x = 0;
			y += 8;
			if ((y + 8) > ST7735_HEIGHT)
				y = 0;
		}
		s++;
	}
}

void ST7735_DrawFFT(float fft_data[], uint16_t FFT_N, uint16_t SAMPLING_N, uint16_t color)
{
	char tekst[20];
	float max_value, max_f;

	max_value = fft_data[0];
	max_f = 0;
	for (uint16_t i = 1; i < FFT_N; i++) {
		if (fft_data[i] > max_value) {
			max_value = fft_data[i];
			max_f = (1.0*i * SAMPLING_N) / FFT_N / 2;
		}
	}

	float resolution = 30.0;
	uint16_t i, x, y;

	x = BIN_WIDTH;
	for (i = 0; i < FFT_N; i++) {
			//y = (resolution * fft_data[i]) / max_value;
			y = resolution * fft_data[i];

			for (uint8_t c = 0; c < BIN_WIDTH; c++)
				for (uint8_t z = 0; z < y; z++)
					st7735_put_pixel(c+x, 116-z, color);

			x += BIN_WIDTH*2;
	}

	sprintf(tekst, "F: %.2f Hz", max_f);
	ST7735_WriteString(8, 8, tekst, BLUE);
	sprintf(tekst, "Magnitude: %.2f", max_value);
	ST7735_WriteString(8, 16, tekst, BLUE);
}

void ST7735_Clear(void)
{
	for (uint16_t x = 0; x < ST7735_WIDTH; x++)
		for (uint16_t y = 0; y < ST7735_HEIGHT; y++)
			st7735_put_pixel(x, y, BLACK);
}
